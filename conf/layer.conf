## conf/layer.conf
```bitbake
# We have a conf and classes directory, add to BBPATH
BBPATH .= ":${LAYERDIR}"

# We have recipes-* directories, add to BBFILES
BBFILES += "${LAYERDIR}/recipes-*/*/*.bb \
	${LAYERDIR}/recipes-*/*/*.bbappend"

BBFILE_COLLECTIONS += "zynqberry-pxfmini"
BBFILE_PATTERN_zynqberry-pxfmini = "^${LAYERDIR}/"
BBFILE_PRIORITY_zynqberry-pxfmini = "6"
```
